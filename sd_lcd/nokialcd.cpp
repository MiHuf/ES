#include "nokialcd.h"
#include <Arduino.h>
#include <SPI.h>

unsigned char font[95][6] =
{
{ 0x00, 0x00, 0x00, 0x00, 0x00, 0x00 }, // space
{ 0x00, 0x00, 0x5F, 0x00, 0x00, 0x00 }, // !
{ 0x00, 0x07, 0x00, 0x07, 0x00, 0x00 }, // "
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{ 0x10, 0x08, 0x08, 0x10, 0x08, 0x00 } // ~
};

NokiaLCD::NokiaLCD() {}

void NokiaLCD::init(uint8_t pinSCE, uint8_t pinRES, uint8_t pinDC)
{
  pinSCE_ = pinSCE;
  pinDC_ = pinDC;
  
  // Reset the display
  pinMode(pinRES, OUTPUT);
  digitalWrite(pinRES, LOW);
  delay(500);
  digitalWrite(pinRES, HIGH);
  
  // Initialize data/command mode (HIGH -> data, LOW -> command)
  pinMode(pinDC_, OUTPUT);
  digitalWrite(pinDC_, HIGH);
  
  // Initialize serial peripheral interface
  SPI.begin(pinSCE_);
  SPI.setClockDivider(pinSCE_, 84);  // 1MHz frequency on the Arduino Due
  SPI.setBitOrder(pinSCE_, MSBFIRST);
  
  // Perform display initialization
  writeCommand(0x21); // FUNCTION SET (EXTENDED)
  writeCommand(0x14); // BIAS
  writeCommand(0xB0); // CONTRAST
  writeCommand(0x20); // FUNCTION SET (NORMAL)
  writeCommand(0x0C); // DISPLAY NORMAL
  writeCommand(0x40); // SET Y = 0;
  writeCommand(0x80); // SET X = 0;
}

/*
 * De-/activate the pixel at the given coordinates
 */
bool NokiaLCD::setPixel(uint8_t pX, uint8_t pY, uint8_t onoff)
{
  bool result = true;
  // Validate argument values
  if (pX < LCD_RESX && pY < LCD_RESY && onoff < 2)
  {
    // Determine the display column (byte in the buffer)
    uint16_t column = (pY/8) * LCD_RESX + pX;
    // Determine the bit position corresponding to the pixel
    uint8_t bitpos = pY%8;
    // De-/activate the pixel
    if (!onoff) { buffer[column] = buffer[column] & ~(0x01 << bitpos);}
    else { buffer[column] = buffer[column] | (0x01 << bitpos); }
  }
  else { result = false; }
  return result;
}

/*
 * Write a character at the given position (if possible)
 */
bool NokiaLCD::writeChar(uint8_t pX, uint8_t pY, const char ch)
{
  bool result = true;
  // Validate argument values
  if (pX < LCD_RESX - 6 && pY < LCD_RESY - 8 && ch >= 0x20 && ch <= 0x7E)
  {
    // Determine the row index for the font array
    uint8_t row = ch - 0x20;
    for (uint8_t i = 0; i < 6; i++)
    {
      // Retrieve character bytes from the font array
      uint8_t fch = font[row][i];
      for (uint8_t j = 0; j < 8; j++)
      {
        // Set all corresponding pixels
        setPixel(pX + i, pY + j, (fch >> j) & 0x01);
      }
    }
  }
  else { result = false; }
  return result;
}

/*
 * Write a line (string) at the given position
 */
bool NokiaLCD::writeLine(uint8_t pX, uint8_t pY, const char *str)
{
  bool result = true;
  for (uint8_t i = 0; i < strlen(str); i++)
  {
    // Write each character of the given string
    if (!writeChar(pX, pY, str[i]))
    {
      result = false;
      break;
    }
    pX += 6;
  }
  return result;
}

/*
 * Clear the display buffer
 */
void NokiaLCD::clearBuffer() { memset(buffer, 0, LCD_BUFSIZE); }

/*
 * Write the contents of the buffer to the display
 */
void NokiaLCD::displayBuffer()
{
  writeCommand(0x40); // Set bank address to 0 (Y)
  writeCommand(0x80); // Set column address to 0 (X)
  
  uint8_t *ptr = buffer;
  for (int i = 0; i < LCD_BUFSIZE; i++) { writeData(*ptr++); }
}

/*
 * Writes a command byte to the display, pinDC -> LOW
 */
void NokiaLCD::writeCommand(uint8_t cmd)
{
  digitalWrite(pinDC_, LOW);
  SPI.transfer(pinSCE_, cmd);
}

/*
 * Writes a data byte to the display, pinDC -> HIGH
 */
void NokiaLCD::writeData(uint8_t data)
{
  digitalWrite(pinDC_, HIGH);
  SPI.transfer(pinSCE_, data);
}
